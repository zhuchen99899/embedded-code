#include <stm32f10x.h>
#include <tem.h>

/*
0-350°
温度-电阻对照表
分度为1°
*/

const float PT100[351]=
{100,100.39,100.78,101.17,101.56,101.95,102.34,102.73,103.13,103.51,103.9,    //0~10°电阻
104.29,104.68,105.07,105.46,105.85,106.24,106.63,107.02,107.40,107.79,         //11°~20°电阻
108.18,108.57,108.96,109.35,109.73,110.12,110.51,110.90,111.28,111.67,         //21°~30°电阻
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226.56,226.90,227.26,227.61,227.96,228.31,228.66,229.02,229.34,229.72			//341°~350°电阻
};

float find_PT100(float res)     //两分法
{
	u32 start,mid,end;
	float dat;
	
	start=0;
	end=350;
	
	if  ((dat<100)||(dat>229.72))
	{
	return 0xFFFF;     //超出表的范围
	
	}
	while(start<=end)
	{
		mid=(end+start)>>1;  //mid=(end+start)/2
		dat=PT100[mid];
		if(res>dat)      //如果数据大于下标
		{
		start=mid+1;       //表起始位置+1
		}
		else if(res<dat)  //如果电阻小于表中数据
		{
			if(mid)    //mid!=0 表没有查完
			{
			end=mid-1;    //表结尾位置-1
			
			}
			else        //mid=0 即END+START=0 表已经查完
			{
			break;  
			}
		}
		else         //res=dat AD测得电阻正好为表中值
		{
			return mid;    //返回表下标值
		}
			
	}
	return mid;      //返回表下标值
};

float get_tem(float res)
{
u16 index=0;
float temp=0;

index=find_PT100(res); //获得下标

	if(0xFFFF==index)     //数据不对
	{
		return 0xFFFF;
		
	}
	if(PT100[index]==res) //数据正好相等
		{
		temp=index;  //取出温度
		}
		else
		{
			if(PT100[index]>res)   //查找到的温度下标对应电阻大于res
			{
			temp=index-1 + (res-PT100[index-1])/(PT100[index]-PT100[index-1]);     //默认这段为线性，比例算出res对应温度
			}
			else             //下标小于res
			{
			temp=index+(res-PT100[index])/(PT100[index+1]-PT100[index]);
			}
		}
		
		
		return temp;
		
		
}

